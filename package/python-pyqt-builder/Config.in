## package/python-pyqt-builder/Config.in
```kconfig
config BR2_PACKAGE_PYTHON_PYQT_BUILDER
	bool "python-pyqt-builder"
	help
	  PyQt-builder is the PEP 517 compliant build system for PyQt
	  and projects that extend PyQt. It extends the SIP build
	  system and uses Qt’s qmake to perform the actual compilation
	  and installation of extension modules.
```

## package/python-pyqt5-sip/Config.in
```kconfig
config BR2_PACKAGE_PYTHON_PYQT5_SIP
	bool "python-pyqt5-sip"
	help
	  This is the PyQt5.sip module which is needed to run PyQt5.
```
